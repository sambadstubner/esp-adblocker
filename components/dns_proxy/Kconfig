## components/dns_proxy/Kconfig
```kconfig
menu "DNS Proxy Configuration"

    config DNS_PROXY_PORT
        int "DNS listen port"
        default 53

    config DNS_PROXY_MAX_PENDING
        int "Max concurrent in-flight upstream queries"
        default 32
        help
            Fixed-size pending-query table. A new client query when the table
            is full gets an immediate SERVFAIL rather than being queued.

    config DNS_PROXY_UPSTREAM_TIMEOUT_MS
        int "Upstream response timeout (ms)"
        default 3000
        help
            If no upstream reply arrives within this window, the client gets
            a synthesized SERVFAIL and the slot is freed.

    config DNS_PROXY_UPSTREAM_FAIL_THRESHOLD
        int "Consecutive timeouts before failing over to the other upstream"
        default 5

    config DNS_PROXY_TASK_STACK
        int "Proxy task stack size (bytes)"
        default 4096

    config DNS_PROXY_TASK_PRIORITY
        int "Proxy task priority"
        default 5

endmenu
```

## components/eth_init/Kconfig
```kconfig
menu "Ethernet (W5500) Configuration"

    config ETH_INIT_SPI_HOST
        int "SPI host for W5500"
        default 1
        help
            SPI peripheral used for the W5500 Ethernet chip.
            0 = SPI1_HOST (reserved for flash, do not use)
            1 = SPI2_HOST
            2 = SPI3_HOST
            The SD card (sd_storage component) must use a different host than this one.

    config ETH_INIT_MISO_GPIO
        int "W5500 MISO GPIO"
        default 12
        help
            Confirmed pinout for the Waveshare ESP32-S3-ETH onboard W5500.

    config ETH_INIT_MOSI_GPIO
        int "W5500 MOSI GPIO"
        default 11

    config ETH_INIT_SCLK_GPIO
        int "W5500 SCLK GPIO"
        default 13

    config ETH_INIT_CS_GPIO
        int "W5500 CS GPIO"
        default 14

    config ETH_INIT_RST_GPIO
        int "W5500 RST GPIO"
        default 9

    config ETH_INIT_INT_GPIO
        int "W5500 INT GPIO"
        default 10

    config ETH_INIT_SPI_CLOCK_MHZ
        int "W5500 SPI clock speed (MHz)"
        default 20
        help
            W5500 supports higher clocks depending on board wiring quality;
            20MHz is the conservative default used by Espressif's own examples.

endmenu
```

## components/sd_storage/Kconfig
```kconfig
menu "SD Card (TF slot) Configuration"

    config SD_STORAGE_SPI_HOST
        int "SPI host for TF/SD card"
        default 2
        help
            SPI peripheral used for the onboard TF card slot. Must differ from
            ETH_INIT_SPI_HOST so Ethernet and the SD card can run concurrently
            on independent buses.
            0 = SPI1_HOST (reserved for flash, do not use)
            1 = SPI2_HOST
            2 = SPI3_HOST

    config SD_STORAGE_MISO_GPIO
        int "TF card MISO (DO) GPIO"
        default 5
        help
            Confirmed pinout for the Waveshare ESP32-S3-ETH onboard TF card slot.

    config SD_STORAGE_MOSI_GPIO
        int "TF card MOSI (DI) GPIO"
        default 6

    config SD_STORAGE_SCLK_GPIO
        int "TF card SCLK GPIO"
        default 7

    config SD_STORAGE_CS_GPIO
        int "TF card CS GPIO"
        default 4

    config SD_STORAGE_FORMAT_IF_MOUNT_FAILED
        bool "Format card as FAT32 if mount fails"
        default y
        help
            If the card can't be mounted as-is (e.g. it still has a foreign/Linux
            partition table from prior use), wipe it and lay down a fresh FAT32
            volume instead of failing. Safe to leave on for this appliance since
            the card only ever holds the derived block-list index, never
            irreplaceable data.

    config SD_STORAGE_MAX_FILES
        int "Max simultaneously open files"
        default 4

endmenu
```
